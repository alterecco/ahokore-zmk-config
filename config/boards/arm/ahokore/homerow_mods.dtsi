#include "keycodes.h"

hm: homerow_mods {
  compatible = "zmk,behavior-hold-tap";
  label = "HOMEROW_MODS";
  #binding-cells = <2>;
  tapping_term_ms = <300>;
  flavor = "tap-preferred";
  bindings = <&kp>, <&kp>;
};

hl: homerow_mods {
  compatible = "zmk,behavior-hold-tap";
  label = "HOMEROW_LAYERS";
  #binding-cells = <2>;
  tapping_term_ms = <300>;
  flavor = "tap-preferred";
  bindings = <&mo>, <&kp>;
};

#define HT_LS  &hm LEFT_SHIFT
#define HT_LC  &hm LEFT_CONTROL
#define HT_LA  &hm LEFT_ALT
#define HT_LG  &hm LEFT_GUI

#define HT_RS  &hm RIGHT_SHIFT
#define HT_RC  &hm RIGHT_CONTROL
#define HT_RA  &hm RIGHT_ALT
#define HT_RG  &hm RIGHT_GUI

#define HL_NUM &hl NUM

#define o__S__o &hm LEFT_SHIFT S
#define o__H__o &hm LEFT_CONTROL H
#define o__N__o &hm LEFT_ALT N
#define o__T__o &hm LEFT_GUI T

#define o__E__o &hm RIGHT_GUI E
#define o__A__o &hm RIGHT_ALT A
#define o__I__o &hm RIGHT_CONTROL I
#define o__O__o &hm RIGHT_SHIFT O
