#include "keycodes.h"

compatible = "zmk,combos";

#define COMBO(NAME, BINDINGS, KEYPOS, LAYERS) \
  combo_##NAME { \
    bindings = <BINDINGS>; \
    key-positions = <KEYPOS>; \
    layers = <LAYERS>; \
  };

/*                KEY POSITIONS

  ╭────────────────────╮ ╭────────────────────╮
  │  0   1   2   3   4 │ │  5   6   7   8   9 │
  │ 10  11  12  13  14 │ │ 15  16  17  18  19 │
  │ 20  21  22  23  24 │ │ 25  26  27  28  29 │
  ╰───────╮ 30  31  32 │ │ 33  34  35 ╭───────╯
          ╰────────────╯ ╰────────────╯
*/

COMBO(enter, &kp ENTER, 16 17, DEF NAV NUM)
COMBO(backspace, &kp BACKSPACE, 6 7, DEF NAV NUM)
COMBO(tab, &kp TAB, 26 27, DEF NAV NUM)
COMBO(escape, &kp ESCAPE, 0 1, DEF NAV NUM)
COMBO(delete, &kp DELETE, 7 8, DEF NAV NUM)

COMBO(left_parenthesis, &kp LEFT_PARENTHESIS, 13 16, DEF)
COMBO(left_brace, &kp LEFT_BRACE, 13 17, DEF)
COMBO(left_bracket, &kp LEFT_BRACKET, 13 18, DEF)
COMBO(less_than, &kp LESS_THAN, 13 19, DEF)
COMBO(right_parenthesis, &kp RIGHT_PARENTHESIS, 13 6, DEF)
COMBO(right_brace, &kp RIGHT_BRACE, 13 7, DEF)
COMBO(right_bracket, &kp RIGHT_BRACKET, 13 8, DEF)
COMBO(more_than, &kp GREATER_THAN, 13 9, DEF)

COMBO(TILDE, &kp TILDE, 12 15, DEF)
COMBO(COLON, &kp COLON, 12 16, DEF)
COMBO(SEMICOLON, &kp SEMICOLON, 12 17, DEF)
COMBO(HASH, &kp HASH, 12 18, DEF)
COMBO(PERCENT, &kp PERCENT, 12 19, DEF)
COMBO(CARET, &kp CARET, 12 5, DEF)
COMBO(PIPE, &kp PIPE, 12 6, DEF)
COMBO(BACKSLASH, &kp BACKSLASH, 12 7, DEF)
COMBO(AT, &kp AT, 12 8, DEF)
COMBO(DOLLAR, &kp DOLLAR, 12 9, DEF)

COMBO(undo, MAC_UNDO, 20 21, DEF)
COMBO(redo, MAC_REDO, 20 10, DEF)
COMBO(copy, MAC_COPY, 21 22, DEF)
COMBO(cut, MAC_CUT, 21 23, DEF)
COMBO(paste, MAC_PASTE, 22 23, DEF)
COMBO(select_all, MAC_SELECT_ALL, 20 23, DEF)

COMBO(tab_left, o_TABL_, 27 28, DEF)
COMBO(tab_right, o_TABR_, 28 29, DEF)

COMBO(aelig, _AELIG_, 8 9, DEF)
COMBO(oslsh, _OSLSH_, 9 19, DEF)
COMBO(aring, _ARING_, 19 29, DEF)

COMBO(num_1, &kp N1, 11 26, DEF)
COMBO(num_2, &kp N2, 11 27, DEF)
COMBO(num_3, &kp N3, 11 28, DEF)
COMBO(num_4, &kp N4, 11 16, DEF)
COMBO(num_5, &kp N5, 11 17, DEF)
COMBO(num_6, &kp N6, 11 18, DEF)
COMBO(num_7, &kp N7, 11 6, DEF)
COMBO(num_8, &kp N8, 11 7, DEF)
COMBO(num_9, &kp N9, 11 8, DEF)
COMBO(num_0, &kp N0, 11 15, DEF)

COMBO(combo_z, &kp Z, 2 3, DEF)
COMBO(combo_q, &kp Q, 1 2, DEF)

//combo_lf {
//  bindings = <&macro_lf>;
//  key-positions = <1 2>;
//  layers = <DEF>;
//};
//combo_lp {
//  bindings = <&macro_lp>;
//  key-positions = <2 3>;
//  layers = <DEF>;
//};
//combo_qu {
//  bindings = <&macro_qu>;
//  key-positions = <26 28>;
//  layers = <DEF>;
//};
