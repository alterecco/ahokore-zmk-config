hm: hold_tap_mods {
  compatible = "zmk,behavior-hold-tap";
  label = "HOLD_TAP_MODS";
  #binding-cells = <2>;
  tapping_term_ms = <300>;
  flavor = "tap-preferred";
  bindings = <&kp>, <&kp>;
};

hl: hold_tap_layers {
  compatible = "zmk,behavior-hold-tap";
  label = "HOLD_TAP_LAYERS";
  #binding-cells = <2>;
  tapping_term_ms = <300>;
  flavor = "tap-preferred";
  bindings = <&mo>, <&kp>;
};

#define HMLS  &hm LEFT_SHIFT
#define HMLC  &hm LEFT_CONTROL
#define HMLO  &hm LEFT_ALT
#define HMLG  &hm LEFT_GUI

#define HMRS  &hm RIGHT_SHIFT
#define HMRC  &hm RIGHT_CONTROL
#define HMRO  &hm RIGHT_ALT
#define HMRG  &hm RIGHT_GUI

#define HLNUM &hl NUM
#define HLNAV &hl NAV
#define HLWIN &hl WIN
#define HLSYS &hl SYS
